## config/west.yml
```yaml
manifest:
  remotes:
    - name: zmkfirmware
      url-base: https://github.com/zmkfirmware
    - name: sayu-hub  # pmw3610-driverのフォーク
      url-base: https://github.com/sayu-hub
  projects:
    - name: zmk
      remote: zmkfirmware
      revision: main
      path: zmk
      import: app/west.yml
    - name: zmk-pmw3610-driver
      remote: sayu-hub
      revision: main
      path: modules/zmk-pmw3610-driver
  self:
    path: config
```
